ENTRY (main)
STARTUP("user/crt/crt_asm.o")
OUTPUT_FORMAT("binary")

SECTIONS{
    . = 0x10000000;

    .text :{
        *(.text)
    }

    .rodata ALIGN (0x1000) : {
        *(.rodata)
    }

    .data ALIGN (0x1000) : {
        *(.data)
    }

    .bss : {
        sbss = .;
        *(COMMON)
        *(.bss)
        ebss = .;
    }
}
